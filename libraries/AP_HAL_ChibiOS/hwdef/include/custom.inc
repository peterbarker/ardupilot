unenv AP_PERIPH

define AP_BOOTLOADER_FLASHING_ENABLED 0

define AP_AHRS_ENABLED 0
define AP_AIRSPEED_ENABLED 0
define AP_ARMING_ENABLED 0
define AP_CAN_SLCAN_ENABLED 0
define AP_COMPASS_ENABLED 0
define AP_FENCE_ENABLED 0
define AP_FRSKY_TELEM_ENABLED 0
define AP_GPS_DRONECAN_ENABLED 0
define AP_MISSION_ENABLED 0
define AP_RCMAPPER_ENABLED 0
define AP_RCPROTOCOL_ENABLED 0
define AP_RELAY_ENABLED 0
define AP_RSSI_ENABLED 0
define AP_RTC_ENABLED 0
define AP_SCHEDULER_ENABLED 0
define AP_SMARTAUDIO_ENABLED 0
define AP_VIDEOTX_ENABLED 0
define HAL_BUTTON_ENABLED 0
define HAL_ENABLE_DRONECAN_DRIVERS 0
define HAL_GCS_ENABLED 0
define HAL_GENERATOR_ENABLED 0
define HAL_HOTT_TELEM_ENABLED 0
define HAL_LOGGING_ENABLED 0
define HAL_MSP_ENABLED 0
define HAL_PICCOLO_CAN_ENABLE 0
define HAL_RUNCAM_ENABLED 0
define HAL_SPEKTRUM_TELEM_ENABLED 0
define HAL_WITH_ESC_TELEM 0
define OSD_ENABLED 0
